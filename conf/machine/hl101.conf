## conf/machine/hl101.conf
```bitbake
require conf/machine/include/oem-sh4.inc
require conf/machine/include/smallflash.inc

PREFERRED_PROVIDER_virtual/kernel = "linux-sh4-${MACHINE}"

ROOTFS_FILE = "root.img"
KERNEL_FILE = "uImage"

IMAGE_FSTYPES += "tar.gz"

MACHINE_FEATURES += "ci hl101"

AUDIOELF = "audio_7109.elf"
VIDEOELF = "video_7109.elf"

SOC_FAMILY = "sti7109"

DVB1FIRMWARE = "dvb-fe-avl2108.fw"
DVB2FIRMWARE = "dvb-fe-stv6306.fw"

MACHINE_ESSENTIAL_EXTRA_RDEPENDS += "\
    firmware-sh4-stm \
"
```

## conf/machine/vip1_v2.conf
```bitbake
require conf/machine/include/oem-sh4.inc
require conf/machine/include/viphl.inc
require conf/machine/include/smallflash.inc

MACHINE_FEATURES += "vip1_v2"

MACHINE_ESSENTIAL_EXTRA_RDEPENDS += "\
    evremote2 \
"
```
